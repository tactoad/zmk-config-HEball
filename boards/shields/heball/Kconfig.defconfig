## boards/shields/heball/Kconfig.defconfig
```kconfig
if SHIELD_HEBALL_RIGHT

config ZMK_KEYBOARD_NAME
    default "HEball"

config ZMK_SPLIT
    default y

config ZMK_SPLIT_ROLE_CENTRAL
    default y

config INPUT
    default y

config ZMK_POINTING
    default y

config SPI
    default y

config PMW3610_ALT
    default y

endif

if SHIELD_HEBALL_LEFT

config ZMK_KEYBOARD_NAME
    default "HEball_L"

config ZMK_SPLIT
    default y

endif
```

## boards/shields/heball/Kconfig.shield
```kconfig
config SHIELD_HEBALL_LEFT
    def_bool $(shields_list_contains,heball_left)

config SHIELD_HEBALL_RIGHT
    def_bool $(shields_list_contains,heball_right)
```
